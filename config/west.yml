## config/west.yml
```yaml
manifest:
  remotes:
    - name: aaron-j-reeves
      url-base: https://github.com/aaron-j-reeves
  projects:
    - name: zmk
      remote: aaron-j-reeves
      revision: main
      import: app/west.yml
  self:
    path: config
```
